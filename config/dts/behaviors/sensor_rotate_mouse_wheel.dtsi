/*
 * Copyright (c) 2022-2023 XiNGRZ
 * SPDX-License-Identifier: MIT
 */
#include "dt-bindings/zmk/mouse.h"

/ {
	behaviors {
		/omit-if-no-ref/ mw: behavior_sensor_rotate_mouse_wheel {
			compatible = "zmk,behavior-sensor-rotate-mouse-wheel";
			label = "ENC_MOUSE_WHEEL";
			#sensor-binding-cells = <2>;
		};

		inc_dec_mwh: behavior_sensor_rotate_mouse_wheel_horizontal {
			compatible = "zmk,behavior-sensor-rotate-mouse-wheel";
			label = "ENC_MOUSE_WHEEL";
			#sensor-binding-cells = <2>;
		};
	};
};
